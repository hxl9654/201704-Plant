//功能描述：1602液晶的显示及设置
#include<stc15.h>
#include<1602.h>

sbit LCD1602_RS = DEFLCD1602_RS;
sbit LCD1602_RW = DEFLCD1602_RW;
sbit LCD1602_E = DEFLCD1602_E;
/*///////////////////////////////////////////////////////////////////////////////////
*函数名：Delay5ms
*函数功能：5ms延时函数（请不要直接调用）
*////////////////////////////////////////////////////////////////////////////////////
void Delay5ms()		
{
	unsigned char i, j;

	i = 5 * XTAL;
	j = 218;
	do
	{
		while (--j);
	} while (--i);
}

/*///////////////////////////////////////////////////////////////////////////////////
*函数名：LCD1602_Wait
*函数功能：等待LCD1602空闲（请不要直接调用）
*////////////////////////////////////////////////////////////////////////////////////
void LCD1602_Wait()
{
	unsigned char a;
	LCD1602_RS = 0;	//0命令，1数据
	LCD1602_RW = 1;	//0写1读
	LCD1602_DB = 0xFF;
	do
	{
		LCD1602_E = 1;
		a = LCD1602_DB;
		LCD1602_E = 0;
	}while(a & 0x80);
}
/*///////////////////////////////////////////////////////////////////////////////////
*函数名：LCD1602_WriteData
*函数功能：向LCD1602发送数据（请不要直接调用）
*参数列表：
*   dat
*       参数类型：unsigned char型整数
*       参数描述：要发送的数据
*////////////////////////////////////////////////////////////////////////////////////
void LCD1602_WriteData(unsigned char dat)
{
	LCD1602_Wait();
	LCD1602_RW = 0;
	LCD1602_RS = 1;
	LCD1602_DB = dat;
	LCD1602_E = 1;
	LCD1602_E = 0;
}
/*///////////////////////////////////////////////////////////////////////////////////
*函数名：LCD1602_WriteCMD
*函数功能：向LCD1602发送命令（请不要直接调用）
*参数列表：
*   cmd
*       参数类型：unsigned char型整数
*       参数描述：要发送的命令
*////////////////////////////////////////////////////////////////////////////////////
void LCD1602_WriteCMD(unsigned char cmd)
{
	LCD1602_Wait();
	LCD1602_RW = 0;
	LCD1602_RS = 0;
	LCD1602_DB = cmd;
	LCD1602_E = 1;
	LCD1602_E = 0;
}
/*///////////////////////////////////////////////////////////////////////////////////
*函数名：LCD1602_Clear
*函数功能：LCD1602清屏
*////////////////////////////////////////////////////////////////////////////////////
void LCD1602_Clear()
{
	LCD1602_WriteCMD(0x01);
}
/*///////////////////////////////////////////////////////////////////////////////////
*函数名：LCD1602_SetLocation
*函数功能：设置LCD1602光标位置
*参数列表：
*   x
*       参数类型：unsigned char型整数
*       参数描述：横坐标
*   y
*       参数类型：unsigned char型整数
*       参数描述：纵坐标
*////////////////////////////////////////////////////////////////////////////////////
void LCD1602_SetLocation(unsigned char x, unsigned char y)
{
	unsigned char temp;
	if(y == 1)temp = 0x40;
	else temp = 0x00;
	temp += x;
	LCD1602_WriteCMD(temp | 0x80);
}
/*///////////////////////////////////////////////////////////////////////////////////
*函数名：LCD1602_AreaClear
*函数功能：LCD1602范围清屏
*参数列表：
*   x
*       参数类型：unsigned char型整数
*       参数描述：横坐标
*   y
*       参数类型：unsigned char型整数
*       参数描述：纵坐标
*   len
*       参数类型：unsigned char型整数
*       参数描述：要清屏的长度
*////////////////////////////////////////////////////////////////////////////////////
void LCD1602_AreaClear(unsigned char x, unsigned char y, unsigned char len)
{
	LCD1602_SetLocation(x, y);
	while(len--)
	{
		LCD1602_WriteData(' ');
	}
}
/*///////////////////////////////////////////////////////////////////////////////////
*函数名：LCD1602_Show
*函数功能：LCD1602显示字符串
*参数列表：
*   x
*       参数类型：unsigned char型整数
*       参数描述：横坐标
*   y
*       参数类型：unsigned char型整数
*       参数描述：纵坐标
*   dat
*       参数类型：unsigned char型指针
*       参数描述：要显示的字符数组
*   len
*       参数类型：unsigned char型整数
*       参数描述：要显示的长度
*////////////////////////////////////////////////////////////////////////////////////
void LCD1602_Show(unsigned char x, unsigned char y, unsigned char *dat, unsigned char len)
{
	LCD1602_SetLocation(x, y);
	while(len--)
	{
		LCD1602_WriteData(*dat++);
	}
}
/*///////////////////////////////////////////////////////////////////////////////////
*函数名：LCD1602_ShowCursor
*函数功能：打开LCD1602光标
*////////////////////////////////////////////////////////////////////////////////////
void LCD1602_ShowCursor()
{
    LCD1602_WriteCMD(0x0F);
}
/*///////////////////////////////////////////////////////////////////////////////////
*函数名：LCD1602_CloseCursor
*函数功能：关闭LCD1602光标
*////////////////////////////////////////////////////////////////////////////////////
void LCD1602_CloseCursor()
{
    LCD1602_WriteCMD(0x0C);
}
/*///////////////////////////////////////////////////////////////////////////////////
*函数名：LCD1602_Init
*函数功能：LCD1602初始化函数，在主函数开头调用。
*////////////////////////////////////////////////////////////////////////////////////
void LCD1602_Init()
{
	LCD1602_WriteCMD(0x38);
	Delay5ms();
	LCD1602_WriteCMD(0x38);
	Delay5ms();
	LCD1602_WriteCMD(0x38);
	Delay5ms();
	LCD1602_WriteCMD(0x38);
	LCD1602_WriteCMD(0x0C);
	LCD1602_WriteCMD(0x06);
	LCD1602_WriteCMD(0x01);
}